/*
*
* Copyright (c) 2024 The ZMK Contributors
* SPDX-License-Identifier: MIT
*
*/

#include "eyelash_corne.dtsi"
// Stripped upstream cormoran-specific imports:
//   behaviors/battery_history_request.dtsi
// Comes from cormoran's ZMK fork; we build against zmkfirmware/zmk.

&default_transform {
    col-offset = <7>;
};