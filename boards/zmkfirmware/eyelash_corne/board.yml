## boards/zmkfirmware/eyelash_corne/board.yml
```yaml
boards:
  - name: eyelash_corne_left
    vendor: zmkfirmware
    socs:
      - name: nrf52840
        variants:
          - name: zmk
  - name: eyelash_corne_right
    vendor: zmkfirmware
    socs:
      - name: nrf52840
        variants:
          - name: zmk
```
